## package/packages/net/qts1kpcierpc/Config.in
```kconfig
	menu "Configuration"
		depends on PACKAGE_qts1kpcierpc
		config QUANTENNA_IWINFO_PLUGIN
			bool "Allows for the operating system to query the quantenna wifi card for stats."
			default n
	endmenu
```
